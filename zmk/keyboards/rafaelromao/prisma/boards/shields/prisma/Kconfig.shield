## zmk/keyboards/rafaelromao/prisma/boards/shields/prisma/Kconfig.shield
```kconfig
# Copyright (c) 2021 The ZMK Contributors
# SPDX-License-Identifier: MIT

config SHIELD_PRISMA_CENTRAL_DONGLE
    def_bool $(shields_list_contains,prisma_central_dongle)

config SHIELD_PRISMA_CENTRAL_LEFT
    def_bool $(shields_list_contains,prisma_central_left)

config SHIELD_PRISMA_PERIPHERAL_LEFT
    def_bool $(shields_list_contains,prisma_peripheral_left)

config SHIELD_PRISMA_PERIPHERAL_RIGHT
    def_bool $(shields_list_contains,prisma_peripheral_right)

config SHIELD_PRISMA_CENTRAL_DONGLE_OLED
    def_bool $(shields_list_contains,prisma_central_dongle_oled)

config SHIELD_PRISMA_CENTRAL_TRACKBALL_XIAO
    def_bool $(shields_list_contains,prisma_central_trackball_xiao)

config SHIELD_PRISMA_CENTRAL_TRACKBALL_NANO
    def_bool $(shields_list_contains,prisma_central_trackball_nano)

config SHIELD_PRISMA_CENTRAL_TRACKPAD_XIAO
    def_bool $(shields_list_contains,prisma_central_trackpad_xiao)

config SHIELD_PRISMA_CENTRAL_TRACKPAD_NANO
    def_bool $(shields_list_contains,prisma_central_trackpad_nano)
```
