/* SPDX-License-Identifier: MIT
 * The original 36 logical positions stay identical to both halves.
 * Local direct kscan row 0 is mapped to row 2, positions 36 and 37.
 */
#include "prisma_transform.dtsi"
&default_transform {
    rows = <3>;
    row-offset = <2>;
    map = <
        RC(1,0) RC(0,1) RC(0,4) RC(0,7) RC(1,1) RC(1,12) RC(0,19) RC(0,16) RC(0,13) RC(1,13) RC(0,0) RC(0,2) RC(0,5) RC(0,8) RC(1,2) RC(1,14) RC(0,20) RC(0,17) RC(0,14) RC(0,12) RC(1,3) RC(0,3) RC(0,6) RC(0,9) RC(1,4) RC(1,15) RC(0,21) RC(0,18) RC(0,15) RC(1,16) RC(1,5) RC(0,10) RC(0,11) RC(0,23) RC(0,22) RC(1,17)
        RC(2,0) RC(2,1)
    >;
};
