/*
*
* Copyright (c) 2022 Rafael Romão
* SPDX-License-Identifier: MIT
*
*/

#include <behaviors.dtsi>
#include <dt-bindings/zmk/keys.h>
#include <dt-bindings/zmk/bt.h>

/ {
    chosen {
        zmk,physical-layout = &foostan_corne_5col_layout;
    };
};

/*
 * The board's five_column_transform declares columns = <10> but maps columns
 * 1-10 and still receives column 0 and 11 from the outer switches. ZMK
 * indexes its lookup table as row * columns + col, so those unmapped outer
 * keys landed on real positions (left SW7 -> position 9). Twelve columns
 * keep every pair in its own slot.
 */
&five_column_transform {
    columns = <12>;
};

#include "../../../definitions/keymap.dtsi"
