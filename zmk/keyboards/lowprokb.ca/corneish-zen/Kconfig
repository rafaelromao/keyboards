## zmk/keyboards/lowprokb.ca/corneish-zen/Kconfig
```kconfig
config ZMK_CORNEISH_ZEN_CENTRAL_LOGO
    bool "Show the Corne-ish Zen logo on the central display"
    depends on BOARD_CORNEISH_ZEN_LEFT && ZMK_SPLIT_ROLE_CENTRAL
    depends on ZMK_DISPLAY && ZMK_DISPLAY_STATUS_SCREEN_CUSTOM
    depends on !CUSTOM_WIDGET_LAYER_STATUS
```

## zmk/keyboards/rafaelromao/choc_diamond/boards/shields/choc_diamond/Kconfig.defconfig
```kconfig
# Copyright (c) 2021 The ZMK Contributors
# SPDX-License-Identifier: MIT

if SHIELD_CHOC_DIAMOND_CENTRAL_DONGLE || SHIELD_CHOC_DIAMOND_CENTRAL_LEFT

config ZMK_KEYBOARD_NAME
    default "Choc Diamond"

config ZMK_SPLIT_ROLE_CENTRAL
    default y

endif


# The display is the dongle's; without this guard the LVGL defaults below
# competed with the dongle-display module's own on every other build.
if SHIELD_CHOC_DIAMOND_CENTRAL_DONGLE

if ZMK_DISPLAY

config I2C
    default y

config SSD1306
    default y

choice ZMK_DISPLAY_WORK_QUEUE
    default ZMK_DISPLAY_WORK_QUEUE_DEDICATED
endchoice

endif


if LVGL

config LV_Z_VDB_SIZE
    default 64

config LV_DPI_DEF
    default 148

config LV_Z_BITS_PER_PIXEL
    default 1

choice LV_COLOR_DEPTH
    default LV_COLOR_DEPTH_1
endchoice

endif

endif


if SHIELD_CHOC_DIAMOND_CENTRAL_DONGLE || SHIELD_CHOC_DIAMOND_CENTRAL_LEFT || SHIELD_CHOC_DIAMOND_PERIPHERAL_LEFT || SHIELD_CHOC_DIAMOND_PERIPHERAL_RIGHT

config ZMK_SPLIT
    default y

endif
```

## zmk/keyboards/rafaelromao/prisma/boards/shields/prisma/Kconfig.shield
```kconfig
# Copyright (c) 2021 The ZMK Contributors
# SPDX-License-Identifier: MIT

config SHIELD_PRISMA_CENTRAL_DONGLE
    def_bool $(shields_list_contains,prisma_central_dongle)

config SHIELD_PRISMA_CENTRAL_LEFT
    def_bool $(shields_list_contains,prisma_central_left)

config SHIELD_PRISMA_PERIPHERAL_LEFT
    def_bool $(shields_list_contains,prisma_peripheral_left)

config SHIELD_PRISMA_PERIPHERAL_RIGHT
    def_bool $(shields_list_contains,prisma_peripheral_right)
```

## zmk/modules/zmk-sentence-case/Kconfig
```kconfig
config ZMK_BEHAVIOR_SENTENCE_CASE
    bool
    default y
    depends on DT_HAS_ZMK_BEHAVIOR_SENTENCE_CASE_ENABLED

config ZMK_BEHAVIOR_SENTENCE_MORPH_MAX_HELD
    int "Maximum concurrent positions per sentence-morph instance"
    default 8
    range 1 64
    depends on ZMK_BEHAVIOR_SENTENCE_CASE
```

## zmk/modules/zmk-sentence-case/dts/bindings/behaviors/zmk,behavior-sentence-case.yaml
```yaml
description: Space with a lazy, letter-only sentence-case one-shot shift
compatible: "zmk,behavior-sentence-case"
include: zero_param.yaml

properties:
  prior-idle-ms:
    type: int
    default: 2000
    description: Maximum time between sentence-ending punctuation and space
  release-after-ms:
    type: int
    default: 1000
    description: Time after space during which the one-shot is armed
```

## zmk/modules/zmk-sentence-case/dts/bindings/behaviors/zmk,behavior-sentence-morph.yaml
```yaml
description: Select a binding depending on whether sentence capitalization is pending
compatible: "zmk,behavior-sentence-morph"
include: zero_param.yaml

properties:
  bindings:
    type: phandle-array
    required: true
    description: Normal binding followed by the binding to use while sentence case is armed
```

## zmk/tests/native/dts/bindings/test,keymap-marker.yaml
```yaml
description: Native-test-only output boundary; never emits HID events
compatible: "test,keymap-marker"
include: one_param.yaml
```
