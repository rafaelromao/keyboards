## zmk/keyboards/bastardkb/dilemma/boards/shields/dilemma/Kconfig.shield
```kconfig
# Copyright (c) 2021 The ZMK Contributors
# SPDX-License-Identifier: MIT

config SHIELD_DILEMMA_CENTRAL_DONGLE
    def_bool $(shields_list_contains,dilemma_central_dongle)

config SHIELD_DILEMMA_CENTRAL_LEFT
    def_bool $(shields_list_contains,dilemma_central_left)

config SHIELD_DILEMMA_PERIPHERAL_LEFT
    def_bool $(shields_list_contains,dilemma_peripheral_left)

config SHIELD_DILEMMA_PERIPHERAL_RIGHT
    def_bool $(shields_list_contains,dilemma_peripheral_right)
```

## zmk/keyboards/lowprokb.ca/corneish-zen-with-dongle/boards/shields/corneish-zen-with-dongle/Kconfig.shield
```kconfig
# Copyright (c) 2021 The ZMK Contributors
# SPDX-License-Identifier: MIT

config SHIELD_CORNEISH_ZEN_DONGLE
	def_bool $(shields_list_contains,corneish_zen_dongle)
```

## zmk/keyboards/mabroum/wired_rommana/boards/shields/wired_rommana/Kconfig.defconfig
```kconfig
# Copyright (c) 2021 The ZMK Contributors
# SPDX-License-Identifier: MIT

if SHIELD_WIRED_ROMMANA_LEFT

config ZMK_KEYBOARD_NAME
    default "Wired Rommana"

config ZMK_SPLIT_ROLE_CENTRAL
    default y

endif

if SHIELD_WIRED_ROMMANA_LEFT || SHIELD_WIRED_ROMMANA_RIGHT

config ZMK_SPLIT
    default y

endif
```

## zmk/keyboards/rafaelromao/choc_diamond/boards/shields/choc_diamond/Kconfig.shield
```kconfig
# Copyright (c) 2021 The ZMK Contributors
# SPDX-License-Identifier: MIT

config SHIELD_CHOC_DIAMOND_CENTRAL_DONGLE
    def_bool $(shields_list_contains,choc_diamond_central_dongle)

config SHIELD_CHOC_DIAMOND_CENTRAL_LEFT
    def_bool $(shields_list_contains,choc_diamond_central_left)

config SHIELD_CHOC_DIAMOND_PERIPHERAL_LEFT
    def_bool $(shields_list_contains,choc_diamond_peripheral_left)

config SHIELD_CHOC_DIAMOND_PERIPHERAL_RIGHT
    def_bool $(shields_list_contains,choc_diamond_peripheral_right)
```

## zmk/keyboards/rafaelromao/diamond/boards/shields/diamond/Kconfig.shield
```kconfig
# Copyright (c) 2021 The ZMK Contributors
# SPDX-License-Identifier: MIT

config SHIELD_DIAMOND_CENTRAL_DONGLE
    def_bool $(shields_list_contains,diamond_central_dongle)

config SHIELD_DIAMOND_CENTRAL_LEFT
    def_bool $(shields_list_contains,diamond_central_left)

config SHIELD_DIAMOND_PERIPHERAL_LEFT
    def_bool $(shields_list_contains,diamond_peripheral_left)

config SHIELD_DIAMOND_PERIPHERAL_RIGHT
    def_bool $(shields_list_contains,diamond_peripheral_right)
```
