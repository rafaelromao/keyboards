/*
*
* Copyright (c) 2022 Rafael Romão
* SPDX-License-Identifier: MIT
*
*/

// MOVE_* and SCRL_* in dt-bindings/zmk/pointing.h expand these where the
// keymap uses them, so redefining after the include is what makes them apply.
// The lowercase zmk_mouse_default_* names they replaced belong to the
// pre-merge mouse branch and ZMK never read them, so the keyboard ran at the
// defaults (600 and 10).
#undef ZMK_POINTING_DEFAULT_MOVE_VAL
#undef ZMK_POINTING_DEFAULT_SCRL_VAL
#define ZMK_POINTING_DEFAULT_MOVE_VAL 1000  // 600
#define ZMK_POINTING_DEFAULT_SCRL_VAL 20    // 10

&mmv {
  acceleration-exponent = <1>;      // 1
  time-to-max-speed-ms = <400>;     // 300
  delay-ms = <0>;                   // 0
};

&msc {
  acceleration-exponent = <1>;      // 0
  time-to-max-speed-ms = <100>;     // 300
  delay-ms = <0>;                   // 0
};

