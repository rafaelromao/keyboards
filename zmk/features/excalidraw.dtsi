/*
*
* Copyright (c) 2026 Rafael Romão
* SPDX-License-Identifier: MIT
*
*/

/ {
    /*
     * EXCALIDRAW puts the editor's one-letter tool shortcuts on the left hand
     * and leaves the right hand transparent. Its text tool is typed with T, so
     * T also opens EXCAL_TEXT, a copy of the base layout, for the words that
     * follow, and N does the same.
     *
     * The copy is an auto-layer: it stays on for letters, numbers, modifiers
     * and the editing and punctuation keys below, and any other key press
     * turns it off -- which is to say Enter and Esc, from whichever macro,
     * combo or layer they come. Nothing has to be wired into them.
     *
     * Both layers sit at the bottom, below every hold layer, so NAV, NUM and
     * the rest still win over the copy. Auto-layer activates with locking, so
     * mc_base_reset clears both with &lock_off.
     */
    excalidraw {
        smart_excal: smart_excal {
            compatible = "zmk,behavior-auto-layer";
            ignore-alphas;
            ignore-numbers;
            ignore-modifiers;
            #binding-cells = <1>;
            continue-list = <SPACE TAB BSPC DEL LEFT RIGHT UP DOWN HOME END PG_UP PG_DN
                             DOT COMMA SEMI COLON SQT DQT GRAVE TILDE MINUS UNDER PLUS EQUAL
                             STAR FSLH BSLH PIPE AMPS HASH AT DOLLAR PRCNT CARET EXCL QMARK
                             LPAR RPAR LBRC RBRC LBKT RBKT LT GT>;
        };

        MACRO(mc_excal_text,    &kp T &smart_excal EXCAL_TEXT)
        MACRO(mc_excal_n,       &kp N &smart_excal EXCAL_TEXT)
    };
};
