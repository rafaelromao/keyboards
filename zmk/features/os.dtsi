/*
*
* Copyright (c) 2026 Rafael Romão
* SPDX-License-Identifier: MIT
*
*/

/ {
    /*
     * Ask the host which OS it is, instead of being told
     * (rafaelromao/zmk-os-detection).
     *
     * Every build targets Linux, so ALT_OS means "this host is a Mac" -- the
     * same thing OS_MORPH reads it as. This used to be stated relative to a
     * build flag, and the mapping was flipped to match whichever OS the flag
     * named; there is one firmware per board now, so it is just written out.
     *
     * This is the omarchy / macos keys, done automatically. Those keys stay:
     * they are the answer when detection is wrong or silent, and the module
     * never contests a host it could not identify. What changes is that a host
     * is usually right the first time it is plugged in, instead of the second.
     *
     * A per-endpoint replay used to cover the fraction of a second between the
     * endpoint being selected and a fingerprint settling. Detection turned out
     * to be quick enough on its own, so that came back out again -- this is the
     * only thing driving ALT_OS now.
     */
    os_detection {
        compatible = "zmk,os-detection";
        layer = <ALT_OS>;
        activate-for = "macos";
        deactivate-for = "linux";
    };
};
