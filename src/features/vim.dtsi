/*
*
* Copyright (c) 2025 Rafael Romão
* SPDX-License-Identifier: MIT
*
*/

#include <dt-bindings/zmk/hid_usage.h>


/ {
    /*
     * The host (zmk-vim-mode) encodes the editor's state as a 3-bit code in
     * the HID LED indicator report and this node decodes it into layers.
     *
     * Compose, Kana and Scroll Lock carry the code because no operating system
     * drives them on its own: Linux compositors write all five indicators on
     * every LED change but never *set* these three, and macOS never touches
     * them. Num Lock and Caps Lock are deliberately not used -- the OS owns
     * them, so a stray lock keypress would otherwise change the vim state.
     *
     * The old num_lock listener that toggled vim mode lived here and has been
     * removed for exactly that reason.
     *
     * Codes 4 and 7 are "legacy": the host says a vim-like editor is focused
     * but cannot say which mode it is in, so the keyboard infers modes itself
     * by watching the keys pressed, as it always did. That covers editors
     * without a plugin, vim over SSH (recognised by the window title alone),
     * and the manual combos below -- entering vim mode by hand is the same
     * thing seen from the other side.
     */
    vim_sync: vim_sync {
        compatible = "zmk,hid-indicator-code-listener";
        indicators = <HID_USAGE_LED_COMPOSE HID_USAGE_LED_KANA HID_USAGE_LED_SCROLL_LOCK>;
        managed-layers = <VIM_NORMAL VIM_VISUAL VIM_CHANGE VIM_INSERT VIM_REPLACE VIM_CMDLINE>;
        off-delay-ms = <100>;
        local-guard-ms = <150>;

        normal        { code = <1>; layers = <VIM_NORMAL>; };
        insert        { code = <2>; layers = <VIM_INSERT>; };
        visual        { code = <3>; layers = <VIM_NORMAL VIM_VISUAL>; };
        legacy        { code = <4>; layers = <VIM_NORMAL>; bindings = <&vim_mode_on_host>; };
        cmdline       { code = <5>; layers = <VIM_CMDLINE>; };
        raw           { code = <6>; };
        legacy_silent { code = <7>; layers = <VIM_NORMAL>; };
        /* code 0 is implicit: every managed layer off. */
    };
};

/*  HELPER MACROS  */

#define VIM_MACRO(NAME, BINDINGS) \
    NAME: NAME { \
        compatible = "zmk,behavior-macro"; \
        #binding-cells = <0>; \
        wait-ms = <5>; \
        tap-ms = <5>; \
        bindings = <BINDINGS>; \
    };

// Layer-only macro: no keystrokes, so no reason to pace the bindings. A vim
// mode switch is six or seven toggles; at 5 ms each that delay is felt on
// every Esc.
#define VIM_LAYER_MACRO(NAME, BINDINGS) \
    NAME: NAME { \
        compatible = "zmk,behavior-macro"; \
        #binding-cells = <0>; \
        wait-ms = <0>; \
        tap-ms = <0>; \
        bindings = <BINDINGS>; \
    };

#define VIM_BINDING( \
        NAME, \
        LAYERS, \
        MORPHED_BINDING, \
        DEFAULT_BINDING \
    ) \
    NAME: NAME { \
        compatible = "zmk,behavior-layer-morph"; \
        #binding-cells = <0>; \
        layers = <LAYERS>; \
        bindings \
            = <DEFAULT_BINDING> \
            , <MORPHED_BINDING> \
            ; \
    };

#define VIM_MOD_MORPH(NAME, MODS, MODDED, UNMODDED) \
    NAME: NAME { \
        compatible = "zmk,behavior-mod-morph"; \
        #binding-cells = <0>; \
        bindings = <UNMODDED>, <MODDED>; \
        mods = <(MODS)>; \
        keep-mods = <(MODS)>; \
    };

/ {
    vim {
        /*
         * ENTERING AND LEAVING VIM MODE BY HAND (legacy, codes 4 and 7)
         *
         * The combos cb_vim_mode, cb_enter_vim and cb_leave_vim bind these.
         * Both notifications are chords the host binds to `zmk-vim-mode set
         * legacy --sticky` and `set off --sticky`, so the daemon follows a
         * decision made on the keyboard.
         *
         * vim_mode_on is a layer-morph so that pressing the combo while
         * already in vim mode does nothing, instead of injecting a second Esc.
         *
         * Code 4 must NOT reuse it: the listener clears every managed layer
         * before running a code's bindings, so the morph would always find no
         * vim layer active and always send Hyper+Esc -- which the host reads
         * as the combo, toggling off the override it had just set. Hence the
         * separate vim_mode_on_host, a plain Esc that puts the editor's own
         * vim into normal mode to match the NORMAL layer code 4 selects.
         */
        VIM_MACRO(vim_reset_notify      , &vim_reset &kp LG(LC(LA(LS(ESC)))))
        VIM_MACRO(vim_mode_off          , &vim_off &kp LC(LA(LS(ESC))))
        VIM_BINDING(vim_mode_on         , VIM_NORMAL VIM_VISUAL VIM_CHANGE VIM_INSERT VIM_REPLACE VIM_CMDLINE, &none, &vim_reset_notify)
        VIM_MACRO(vim_mode_on_host      , &kp ESC)

        VIM_LAYER_MACRO(vim_off         , &tog_off VIM_NORMAL &tog_off VIM_CHANGE &tog_off VIM_VISUAL &tog_off VIM_INSERT &tog_off VIM_REPLACE &tog_off VIM_CMDLINE)
        VIM_LAYER_MACRO(vim_normal      , &vim_off &tog_on VIM_NORMAL)
        VIM_LAYER_MACRO(vim_insert      , &vim_off &tog_on VIM_INSERT)
        VIM_LAYER_MACRO(vim_cmdline     , &vim_off &tog_on VIM_CMDLINE)
        VIM_MACRO(vim_reset             , &vim_off &tog_on VIM_NORMAL &kp ESC)
        VIM_MACRO(vim_replace           , &ntsl VIM_REPLACE)

        VIM_MACRO(vim_slash             , &vim_cmdline &kp SLASH)
        VIM_BINDING(lm_slash_vim        , VIM_NORMAL VIM_VISUAL VIM_CHANGE, &vim_slash, &kp SLASH)

        VIM_MACRO(vim_colon             , &vim_cmdline &kp COLON)
        VIM_BINDING(lm_colon_vim        , VIM_NORMAL VIM_VISUAL VIM_CHANGE, &vim_colon, &kp COLON)

        // ? opens the command line exactly as / does, searching backwards.
        VIM_MACRO(vim_qmark             , &vim_cmdline &kp QMARK)
        VIM_BINDING(lm_qmark_vim        , VIM_NORMAL VIM_VISUAL VIM_CHANGE, &vim_qmark, &mc_qmark)

        VIM_MACRO(vim_enter             , &vim_normal &kp ENTER)
        VIM_BINDING(lm_ent_vim          , VIM_CMDLINE, &vim_enter, &kp ENTER)

        VIM_MACRO(vim_esc               , &vim_normal &kp ESC)
        VIM_BINDING(lm_esc_vim          , VIM_VISUAL VIM_CHANGE VIM_INSERT VIM_REPLACE VIM_CMDLINE, &vim_esc, &kp ESC)

        VIM_MACRO(vim_o                 , &kp O &tog_off VIM_NORMAL &tog_off VIM_VISUAL &tog_on VIM_INSERT)
        VIM_MACRO(vim_a                 , &kp A &tog_off VIM_NORMAL &tog_off VIM_VISUAL &tog_on VIM_INSERT)
        VIM_MACRO(vim_i                 , &kp I &tog_off VIM_NORMAL &tog_off VIM_VISUAL &tog_on VIM_INSERT)
        VIM_MACRO(vim_ca                , &kp A &ntsl VIM_CHANGE)
        VIM_MACRO(vim_ci                , &kp I &ntsl VIM_CHANGE)
        VIM_MACRO(vim_c                 , &kp C &tog_off VIM_NORMAL &tog_off VIM_VISUAL &tog_on VIM_INSERT &ntsl VIM_CHANGE)
        VIM_MACRO(vim_s                 , &kp S &tog_off VIM_NORMAL &tog_off VIM_VISUAL &tog_on VIM_INSERT)

        // r waits for one character, so a one-shot layer fits it; R replaces
        // until Esc, which is INSERT's shape -- and what the host reports for
        // Neovim's R (code 2).
        VIM_MACRO(vim_r                 , &kp R &vim_replace)
        VIM_MACRO(vim_sft_r             , &kp R &vim_insert)
        VIM_MOD_MORPH(mm_sft_r_vim      , MOD_LSFT|MOD_RSFT, &vim_sft_r, &vim_r)

        VIM_MACRO(vim_sft_c             , &kp C &tog_off VIM_NORMAL &tog_on VIM_INSERT)
        VIM_MOD_MORPH(mm_sft_c_vim      , MOD_LSFT|MOD_RSFT, &vim_sft_c, &vim_c)

        VIM_MOD_MORPH(vim_a_ctrl_a      , MOD_LCTL|MOD_RCTL, &kp A, &vim_a)
        VIM_MOD_MORPH(vim_i_ctrl_i      , MOD_LCTL|MOD_RCTL, &kp I, &vim_i)
        VIM_MOD_MORPH(vim_o_ctrl_o      , MOD_LCTL|MOD_RCTL, &kp O, &vim_o)
        VIM_MOD_MORPH(vim_s_ctrl_s      , MOD_LCTL|MOD_RCTL, &kp S, &vim_s)
        VIM_MOD_MORPH(vim_r_ctrl_r      , MOD_LCTL|MOD_RCTL, &kp R, &mm_sft_r_vim)

        // Ctrl+C leaves insert or visual just as Esc does, so it must return
        // the keyboard to NORMAL. The layer change has to be wrapped in a
        // macro: a mod-morph takes exactly two bindings, and a third one here
        // was silently ignored. No Esc is sent -- Ctrl+C already said it.
        VIM_MACRO(vim_ctrl_c            , &kp C &vim_normal)
        VIM_MOD_MORPH(vim_c_ctrl_c      , MOD_LCTL|MOD_RCTL, &vim_ctrl_c, &mm_sft_c_vim)

        // VISUAL MODE EXITS

        VIM_MACRO(mc_c_visual_vim       , &kp C &tog_off VIM_VISUAL &tog_on VIM_INSERT)
        VIM_BINDING(lm_c_vim            , VIM_VISUAL, &mc_c_visual_vim , &vim_c_ctrl_c)

        /*
         * v in visual leaves visual -- but only if the editor is told, so the
         * key must be sent, not just the layer changed. Without it the editor
         * stays in visual while the keyboard goes to normal; with the Neovim
         * plugin connected the host then puts VISUAL back and the key looks
         * dead, and in a legacy app the two simply disagree until Esc.
         *
         * V and ^V are different: inside visual they switch sub-mode rather
         * than leave, so they send the key and stay on the layer. There is one
         * VIM_VISUAL layer for all three sub-modes, which is enough.
         */
        VIM_MACRO(mc_v_vim              , &kp V &tog_on VIM_VISUAL)
        VIM_MACRO(mc_v_exit_vim         , &vim_normal &kp V)
        VIM_BINDING(lm_v_vim            , VIM_VISUAL, &mc_v_exit_vim , &mc_v_vim)

        VIM_MACRO(mc_sft_v_vim          , &vim_reset &tog_on VIM_VISUAL &kp LS(V))
        VIM_BINDING(lm_sft_v_vim        , VIM_VISUAL, &kp LS(V) , &mc_sft_v_vim)

        VIM_MACRO(mc_ctl_v_vim          , &vim_reset &tog_on VIM_VISUAL &kp LC(V))
        VIM_BINDING(lm_ctl_v_vim        , VIM_VISUAL, &kp LC(V) , &mc_ctl_v_vim)

        VIM_MACRO(vim_x                 , &vim_normal &kp X)
        VIM_BINDING(lm_x_vim            , VIM_VISUAL, &vim_x, &kp X)

        VIM_MACRO(vim_d                 , &vim_normal &kp D)
        VIM_BINDING(lm_d_vim            , VIM_VISUAL, &vim_d, &kp D)

        VIM_MACRO(vim_y                 , &vim_normal &kp Y)
        VIM_BINDING(lm_y_vim            , VIM_VISUAL, &vim_y, &kp Y)

        VIM_MACRO(vim_p                 , &vim_normal &kp P)
        VIM_BINDING(lm_p_vim            , VIM_VISUAL, &vim_p, &kp P)

        VIM_MACRO(vim_sft_j             , &vim_normal &kp J)
        VIM_MOD_MORPH(mm_sft_j_vim      , MOD_LSFT|MOD_RSFT, &vim_sft_j, &kp J)

        VIM_MACRO(vim_eql               , &vim_normal &kp EQUAL)
        VIM_BINDING(lm_eql_vim          , VIM_VISUAL, &vim_eql, &kp EQUAL)

        VIM_MACRO(vim_tilde             , &vim_normal &kp TILDE)
        VIM_BINDING(lm_tilde_vim        , VIM_VISUAL, &vim_tilde, &kp TILDE)

        VIM_MACRO(vim_excl              , &vim_cmdline &kp EXCL)
        VIM_BINDING(lm_excl_vim         , VIM_VISUAL, &vim_excl, &kp EXCL)

        VIM_MACRO(vim_q                 , &kp Q &vim_replace)
        VIM_BINDING(lm_q_vim            , VIM_NORMAL VIM_VISUAL, &vim_q, &kp Q)

        VIM_MACRO(vim_at                , &kp AT &vim_replace)
        VIM_BINDING(lm_at_vim           , VIM_NORMAL VIM_VISUAL, &vim_at, &kp AT)
    };
};
