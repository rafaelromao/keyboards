/*
*
* Copyright (c) 2026 Rafael Romão
* SPDX-License-Identifier: MIT
*
*/

/ {
    /*
     * The OS belongs to the host, not to the keyboard
     * (rafaelromao/zmk-persistent-layers).
     *
     * ALT_OS says "this host is not the one this firmware was built for", which
     * is a fact about whichever machine is currently selected -- so the module
     * records it against the endpoint and replays it whenever that endpoint
     * comes back, including after a restart. A host teaches itself on connect
     * (rafaelromao/zmk-os-detection, os.dtsi) and the def OS / alt OS keys on
     * the toggles layer override it; either way &bt BT_SEL carries the OS with
     * it from then on.
     *
     * The replay is still what makes the mode feel instant. Detection cannot
     * answer until the host has finished identifying itself, which is a
     * fraction of a second after the endpoint is selected -- this fills that
     * gap, and records whatever detection settles on afterwards.
     *
     * Only ALT_OS belongs here. It is held on by &lock_on, and a restore locks
     * it the same way, which is what makes a mode layer safe to replay. The vim
     * layers must never be added: the host already owns those through vim_sync,
     * and the two would fight at connect time.
     *
     * Nothing is recorded or replayed while the endpoint is NONE, so the mode
     * does not flicker when a host drops.
     */
    persistent_layers {
        compatible = "zmk,persistent-layers";
        layers = <ALT_OS>;
        save-delay-ms = <2000>;
    };
};
