/*
*
* Copyright (c) 2026 Rafael Romão
* SPDX-License-Identifier: MIT
*
*/

/ {
    /*
     * Keyboard -> host: announce the active layers (rafaelromao/zmk-layer-hud).
     *
     * The signal travels on the module's own carriers: a CDC-ACM serial
     * interface over USB, notifications on its own GATT service over BLE. USB
     * builds need the snippet that provides the serial interface:
     *
     *   b d -n layer-hud-usb-uart
     *
     * It used to ride in the keyboard HID report, as reserved keyboard-page
     * usages, on the premise that no OS maps 0xA5-0xDF. Linux does: every
     * unmapped slot in the kernel's hid_keyboard[] table holds the macro `unk`,
     * which is KEY_UNKNOWN (240) rather than zero, so the "if unmapped, ignore"
     * branch never fires and the whole range arrives as keycode 240. Measured
     * with evtest on the Diamond:
     *
     *   MSC_SCAN 700d6 -> KEY_UNKNOWN (240)   NAV, 0xC0 + 22
     *   MSC_SCAN 700df -> KEY_UNKNOWN (240)   the commit usage
     *
     * Every layer change was a phantom key press carrying whatever modifiers
     * were held: holding Gui and touching the nav layer moved Hyprland to
     * another workspace, no digit involved. No base-usage avoids that -- the
     * only keyboard-page usages Linux really ignores are 0x00-0x03, the error
     * and rollover codes. Nothing on the new carriers can be read as a key, and
     * the raised CONFIG_ZMK_HID_KEYBOARD_REPORT_SIZE they needed is gone.
     *
     * `positions` is back on. It was what made combos stop firing: two blocking
     * zmk_endpoint_send_report calls per key press on the system work queue,
     * which is the queue ZMK scans the matrix on, so the next press was
     * timestamped past COMBO_TERM. Both carriers drop a frame rather than wait
     * for one, so a press can no longer be delayed. The Diamond has since run
     * the CDC-ACM carrier with combos working, which is the evidence that was
     * missing when this was last commented out.
     *
     * Without it the HUD lights keys by guessing from the characters typed; with
     * it the keyboard names the position, so chords, combos, macros and modifier
     * keys light the key actually pressed.
     */
    layer_signal {
        compatible = "zmk,layer-signal";
        heartbeat-ms = <2000>;
        positions;
    };
};
