/*
*
* Copyright (c) 2022 Rafael Romão
* SPDX-License-Identifier: MIT
*
*/

#include <behaviors.dtsi>
#include <dt-bindings/zmk/keys.h>
#include <dt-bindings/zmk/bt.h>

/ {
  chosen {
    zmk,matrix_transform = &five_column_transform;
  };
};

#include "../../../../definitions/keymap.dtsi"