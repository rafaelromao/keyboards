/*
*
* Copyright (c) 2022 Rafael Romão
* SPDX-License-Identifier: MIT
*
*/

/ {
    shortcuts {
        
        // Vim

        MACRO(mc_o_esc,                  &macro_tap &kp O &kp ESC)
        MACRO(mc_sft_o_esc,              &macro_tap &kp LS(O) &kp ESC)
        MACRO(mc_shift_tab,              &macro_tap &kp LS(TAB))

        // Shortcuts

        MACRO(mc_clip,                   &macro_tap &kp LC(LA(LS(N9))))
        MACRO(mc_files,                  &macro_tap &kp LC(LA(LS(N8))))
        MACRO(mc_windows,                &macro_tap &kp LC(LA(LS(N7))))
        MACRO(mc_zoom_out,               &macro_tap &kp LC(LA(LS(N6))))
        MACRO(mc_zoom_in,                &macro_tap &kp LC(LA(LS(N5))))
        MACRO(mc_tabs,                   &macro_tap &kp LC(LA(LS(N4))))
        MACRO(mc_preview,                &macro_tap &kp LC(LA(LS(N3))))
        MACRO(mc_calc,                   &macro_tap &kp LC(LA(LS(N2))))
        MACRO(mc_apps,                   &macro_tap &kp LC(LA(LS(N1))))
        MACRO(mc_reset_zoom,             &macro_tap &kp LC(LA(LS(MINUS))))
        MACRO(mc_emoji,                  &macro_tap &kp LC(LA(LS(GRAVE))))
        MACRO(mc_pomodoro,               &macro_tap &kp LC(LA(LS(EQUAL))))

        MACRO(mc_refresh,                &macro_tap &kp LG(LC(LA(LS(N2)))))
        MACRO(mc_close,                  &macro_tap &kp LG(LC(LA(LS(N3)))))

        MACRO(mc_shortcat,               &macro_tap &kp LG(LC(LA(LS(MINUS)))))
        MACRO(mc_reopen,                 &macro_tap &kp LG(LC(LA(LS(EQUAL)))))

        MACRO(mc_hand,                   &macro_tap &kp LG(LC(LA(LS(N7)))))
        MACRO(mc_mic,                    &macro_tap &kp LG(LC(LA(LS(N4)))))
        MACRO(mc_cam,                    &macro_tap &kp LG(LC(LA(LS(N0)))))

        MACRO(mc_meh_b,                  &macro_tap &kp LC(LA(LS(B))))
        MACRO(mc_meh_m,                  &macro_tap &kp LC(LA(LS(M))))
        MACRO(mc_meh_g,                  &macro_tap &kp LC(LA(LS(G))))
        MACRO(mc_meh_l,                  &macro_tap &kp LC(LA(LS(L))))
        MACRO(mc_meh_o,                  &macro_tap &kp LC(LA(LS(O))))
        MACRO(mc_meh_u,                  &macro_tap &kp LC(LA(LS(U))))
        MACRO(mc_meh_n,                  &macro_tap &kp LC(LA(LS(N))))
        MACRO(mc_meh_s,                  &macro_tap &kp LC(LA(LS(S))))
        MACRO(mc_meh_t,                  &macro_tap &kp LC(LA(LS(T))))
        MACRO(mc_meh_r,                  &macro_tap &kp LC(LA(LS(R))))
        MACRO(mc_meh_a,                  &macro_tap &kp LC(LA(LS(A))))
        MACRO(mc_meh_e,                  &macro_tap &kp LC(LA(LS(E))))
        MACRO(mc_meh_f,                  &macro_tap &kp LC(LA(LS(F))))
        MODTAP_TP(th_meh_f,           &mc_meh_f)
        MACRO(mc_meh_c,                  &macro_tap &kp LC(LA(LS(C))))
        MODTAP_TP(th_meh_c,           &mc_meh_c)
        MACRO(mc_meh_p,                  &macro_tap &kp LC(LA(LS(P))))
        MODTAP_TP(th_meh_p,           &mc_meh_p)
        MACRO(mc_meh_h,                  &macro_tap &kp LC(LA(LS(H))))
        MODTAP_TP(th_meh_h,           &mc_meh_h)
        MACRO(mc_meh_w,                  &macro_tap &kp LC(LA(LS(W))))
        MACRO(mc_meh_v,                  &macro_tap &kp LC(LA(LS(V))))
        MACRO(mc_meh_z,                  &macro_tap &kp LC(LA(LS(Z))))
        MACRO(mc_meh_j,                  &macro_tap &kp LC(LA(LS(J))))
        MACRO(mc_meh_q,                  &macro_tap &kp LC(LA(LS(Q))))
        MACRO(mc_meh_k,                  &macro_tap &kp LC(LA(LS(K))))
        MACRO(mc_meh_x,                  &macro_tap &kp LC(LA(LS(X))))
        MACRO(mc_meh_y,                  &macro_tap &kp LC(LA(LS(Y))))
        MACRO(mc_meh_d,                  &macro_tap &kp LC(LA(LS(D))))
        MACRO(mc_meh_i,                  &macro_tap &kp LC(LA(LS(I))))

        LAYERTAP_TP(th_plain1,        &tc_smart_plain1)

        // Navigation

        MACRO(mc_up_end_del,             &macro_tap &kp UP &kp END &kp DEL)
        MACRO(mc_down_home,              &macro_tap &kp DOWN &kp HOME)
        MACRO(mc_down_end,               &macro_tap &kp DOWN &kp END)

        MACRO(mc_meh_comma,              &macro_tap &kp LC(LA(LS(SQT))))
        MODTAP_TP(th_meh_comm,        &mc_meh_comma)
        MACRO(mc_meh_dot,                &macro_tap &kp LC(LA(LS(BACKSLASH))))
        MODTAP_TP(th_meh_dot,         &mc_meh_dot)

        // Meh and Hyper

        MOD_MORPH_KM(mm_comma_meh, MOD_LSFT, &mc_meh_comma, &mc_comma)
        MOD_MORPH_KM(mm_comma_meh_lctl, MOD_LCTL, &mm_comma_meh, &mc_comma)
        MOD_MORPH_KM(mm_comma_meh_lalt, MOD_LALT, &mm_comma_meh_lctl, &mc_comma)

        MOD_MORPH_KM(mm_dot_meh, MOD_LSFT, &mc_meh_dot, &mc_dot)
        MOD_MORPH_KM(mm_dot_meh_lctl, MOD_LCTL, &mm_dot_meh, &mc_dot)
        MOD_MORPH_KM(mm_dot_meh_lalt, MOD_LALT, &mm_dot_meh_lctl, &mc_dot)

        MACRO(mc_meh_space,             &kp LS(LC(LA(SPACE))))
        MACRO(mc_hyper_space,           &kp LS(LC(LA(LG(SPACE)))))
        TAPHOLD_TP(th_hyper_space,   &mc_hyper_space, &mc_hyper)

        mc_meh: mc_meh {
            compatible = "zmk,behavior-macro";
            #binding-cells = <0>;
            wait-ms = <0>;
            tap-ms = <0>;
            bindings = <&macro_press &kp LS(LC(LALT)) &macro_pause_for_release &macro_release &kp LS(LC(LALT))>;
        };

        mc_hyper: mc_hyper {
            compatible = "zmk,behavior-macro";
            #binding-cells = <0>;
            wait-ms = <0>;
            tap-ms = <0>;
            bindings = <&macro_press &kp LS(LC(LA(LGUI))) &macro_pause_for_release &macro_release &kp LS(LC(LA(LGUI)))>;
        };

   };
};
