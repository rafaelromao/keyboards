/*
*
* Copyright (c) 2022 Rafael Romão
* SPDX-License-Identifier: MIT
*
*/

/ {
    select {
        
        // Select Home

        select_home: select_home {
			compatible = "zmk,behavior-macro";
            #binding-cells = <0>;
            wait-ms = <10>;
            tap-ms = <0>;
            bindings = <&macro_tap &kp LS(HOME)>;
        };

        //Select Line

        mc_sel1ln: mc_sel1ln {
			compatible = "zmk,behavior-macro";
            #binding-cells = <0>;
            wait-ms = <0>;
            tap-ms = <0>;
            bindings = <&macro_tap &kp HOME &kp HOME &kp LS(END)>;
        };
        mc_selnln: mc_selnln {
			compatible = "zmk,behavior-macro";
            #binding-cells = <0>;
            wait-ms = <0>;
            tap-ms = <0>;
            bindings = <&macro_tap &kp LS(DOWN) &kp LS(END)>;
        };
        select_line: select_line {
            compatible = "zmk,behavior-adaptive-key";
            #binding-cells = <0>;
            bindings = <&mc_sel1ln>;

            ADAPTIVE(cont_sel_line, &mc_selnln, LS(END))
        };

   };
};
