/*
*
* Copyright (c) 2022 Rafael Romão
* SPDX-License-Identifier: MIT
*
*/

/ {
    select {
        
        // Select Word

        mc_sel1w: mc_sel1w {
			compatible = "zmk,behavior-macro";
            #binding-cells = <0>;
            wait-ms = <0>;
            tap-ms = <0>;
            bindings = <&macro_tap &kp LA(LEFT) &kp LA(RIGHT) &macro_press &kp LA(LS(LEFT)) &macro_pause_for_release &macro_release &kp LA(LS(LEFT))>;
        };
        mc_selpw: mc_selpw {
			compatible = "zmk,behavior-macro";
            #binding-cells = <0>;
            wait-ms = <0>;
            tap-ms = <0>;
            bindings = <&macro_press &kp LA(LS(LEFT)) &macro_pause_for_release &macro_release &kp LA(LS(LEFT))>;
        };
        select_word: select_word {
            compatible = "zmk,behavior-adaptive-key";
            #binding-cells = <0>;
            bindings = <&mc_sel1w>;

            ADAPTIVE(cont_sel_word, &mc_selpw, LA(LS(LEFT)))
        };
   };
};
