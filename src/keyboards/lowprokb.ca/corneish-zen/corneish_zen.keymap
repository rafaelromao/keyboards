/*
*
* Copyright (c) 2022 Rafael Romão
* SPDX-License-Identifier: MIT
*
*/

#include <behaviors.dtsi>
#include <dt-bindings/zmk/keys.h>
#include <dt-bindings/zmk/bt.h>

/ {
    chosen {
        zmk,physical-layout = &foostan_corne_5col_layout;
    };
};

#include "../../../definitions/keymap.dtsi"
