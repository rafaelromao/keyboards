/*
 * Copyright (c) 2021 The ZMK Contributors
 *
 * SPDX-License-Identifier: MIT
 */

#include "dilemma.dtsi"

&default_transform {
    col-offset = <5>;
};

&default_kscan {
	col-gpios
		= <&pro_micro 19 (GPIO_ACTIVE_HIGH | GPIO_PULL_DOWN)>
		, <&pro_micro 6  (GPIO_ACTIVE_HIGH | GPIO_PULL_DOWN)>
		, <&pro_micro 7  (GPIO_ACTIVE_HIGH | GPIO_PULL_DOWN)>
		, <&pro_micro 9  (GPIO_ACTIVE_HIGH | GPIO_PULL_DOWN)>
		, <&pro_micro 8  (GPIO_ACTIVE_HIGH | GPIO_PULL_DOWN)>
		;
};

// Cirque Trackpad on the Right side

&glidepoint {
	status = "okay";
};

// Cirque Trackpad, if the Left side is central, comment otherwise

&glidepoint_split {
	device = <&glidepoint>;
};

// Cirtque Trackpad, if the Right side is central, comment otherwise

// &glidepoint_listener {
//     status = "okay";
// };