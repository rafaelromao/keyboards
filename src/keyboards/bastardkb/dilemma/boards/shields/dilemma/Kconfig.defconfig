## src/keyboards/bastardkb/dilemma/boards/shields/dilemma/Kconfig.defconfig
```kconfig
# Copyright (c) 2021 The ZMK Contributors
# SPDX-License-Identifier: MIT

if SHIELD_DILEMMA_RIGHT

config ZMK_KEYBOARD_NAME
    default "Dilemma"

config ZMK_SPLIT_ROLE_CENTRAL
    default y

endif

if SHIELD_DILEMMA_LEFT || SHIELD_DILEMMA_RIGHT

config ZMK_SPLIT
    default y

endif
```

## src/keyboards/bastardkb/dilemma/boards/shields/dilemma/Kconfig.shield
```kconfig
# Copyright (c) 2021 The ZMK Contributors
# SPDX-License-Identifier: MIT

config SHIELD_DILEMMA_LEFT
    def_bool $(shields_list_contains,dilemma_left)

config SHIELD_DILEMMA_RIGHT
    def_bool $(shields_list_contains,dilemma_right)
```

## src/keyboards/mabroum/rommana/boards/shields/rommana/Kconfig.shield
```kconfig
# Copyright (c) 2021 The ZMK Contributors
# SPDX-License-Identifier: MIT

config SHIELD_ROMMANA_CENTRAL_DONGLE
    def_bool $(shields_list_contains,rommana_central_dongle)

config SHIELD_ROMMANA_CENTRAL_LEFT
    def_bool $(shields_list_contains,rommana_central_left)

config SHIELD_ROMMANA_PERIPHERAL_LEFT
    def_bool $(shields_list_contains,rommana_peripheral_left)

config SHIELD_ROMMANA_PERIPHERAL_RIGHT
    def_bool $(shields_list_contains,rommana_peripheral_right)
```

## src/keyboards/rafaelromao/ticotico/boards/shields/ticotico/Kconfig.defconfig
```kconfig
# Copyright (c) 2021 The ZMK Contributors
# SPDX-License-Identifier: MIT

if SHIELD_TICOTICO_HEAD

config ZMK_KEYBOARD_NAME
    default "TicoTico"

config ZMK_SPLIT_ROLE_CENTRAL
    default y

endif

if SHIELD_TICOTICO_HEAD || SHIELD_TICOTICO_BODY

config ZMK_SPLIT
    default y

config I2C
    default y

endif
```

## src/keyboards/rafaelromao/ticotico/boards/shields/ticotico/Kconfig.shield
```kconfig
# Copyright (c) 2021 The ZMK Contributors
# SPDX-License-Identifier: MIT

config SHIELD_TICOTICO_HEAD
    def_bool $(shields_list_contains,ticotico_head)

config SHIELD_TICOTICO_BODY
    def_bool $(shields_list_contains,ticotico_body)
```

## src/zmk/boards/handwired/boards/shields/aellopos/Kconfig.defconfig
```kconfig
# Copyright (c) 2021 The ZMK Contributors
# SPDX-License-Identifier: MIT

if SHIELD_AELLOPOS

config ZMK_KEYBOARD_NAME
    default "Aellopos"

endif
```

## src/zmk/boards/handwired/boards/shields/cygnus/Kconfig.defconfig
```kconfig
# Copyright (c) 2021 The ZMK Contributors
# SPDX-License-Identifier: MIT

if SHIELD_CYGNUS_CENTRAL_DONGLE || SHIELD_CYGNUS_CENTRAL_LEFT

config ZMK_KEYBOARD_NAME
    default "Cygnus"

config ZMK_SPLIT_ROLE_CENTRAL
    default y

endif


if ZMK_DISPLAY

config I2C
    default y

config SSD1306
    default y

choice ZMK_DISPLAY_WORK_QUEUE
    default ZMK_DISPLAY_WORK_QUEUE_DEDICATED
endchoice

endif


if LVGL

config LV_Z_VDB_SIZE
    default 64

config LV_DPI_DEF
    default 148

config LV_Z_BITS_PER_PIXEL
    default 1

choice LV_COLOR_DEPTH
    default LV_COLOR_DEPTH_1
endchoice

endif


if SHIELD_CYGNUS_CENTRAL_DONGLE || SHIELD_CYGNUS_CENTRAL_LEFT || SHIELD_CYGNUS_PERIPHERAL_LEFT || SHIELD_CYGNUS_PERIPHERAL_RIGHT

config ZMK_SPLIT
    default y

endif
```

## src/zmk/boards/handwired/boards/shields/cygnus/Kconfig.shield
```kconfig
# Copyright (c) 2021 The ZMK Contributors
# SPDX-License-Identifier: MIT

config SHIELD_CYGNUS_CENTRAL_DONGLE
    def_bool $(shields_list_contains,cygnus_central_dongle)

config SHIELD_CYGNUS_CENTRAL_LEFT
    def_bool $(shields_list_contains,cygnus_central_left)

config SHIELD_CYGNUS_PERIPHERAL_LEFT
    def_bool $(shields_list_contains,cygnus_peripheral_left)

config SHIELD_CYGNUS_PERIPHERAL_RIGHT
    def_bool $(shields_list_contains,cygnus_peripheral_right)
```

## src/zmk/boards/handwired/boards/shields/diamond/Kconfig.defconfig
```kconfig
# Copyright (c) 2021 The ZMK Contributors
# SPDX-License-Identifier: MIT

if SHIELD_DIAMOND_DONGLE

config ZMK_KEYBOARD_NAME
    default "Diamond"

config ZMK_SPLIT_ROLE_CENTRAL
    default y

endif


if ZMK_DISPLAY

config I2C
    default y

config SSD1306
    default y

choice ZMK_DISPLAY_WORK_QUEUE
    default ZMK_DISPLAY_WORK_QUEUE_DEDICATED
endchoice

endif


if LVGL

config LV_Z_VDB_SIZE
    default 64

config LV_DPI_DEF
    default 148

config LV_Z_BITS_PER_PIXEL
    default 1

choice LV_COLOR_DEPTH
    default LV_COLOR_DEPTH_1
endchoice

endif


if SHIELD_DIAMOND_DONGLE || SHIELD_DIAMOND_LEFT || SHIELD_DIAMOND_RIGHT

config ZMK_SPLIT
    default y

endif
```

## src/zmk/boards/handwired/boards/shields/diamond/Kconfig.shield
```kconfig
# Copyright (c) 2021 The ZMK Contributors
# SPDX-License-Identifier: MIT

config SHIELD_DIAMOND_DONGLE
    def_bool $(shields_list_contains,diamond_dongle)

config SHIELD_DIAMOND_LEFT
    def_bool $(shields_list_contains,diamond_left)

config SHIELD_DIAMOND_RIGHT
    def_bool $(shields_list_contains,diamond_right)
```

## src/zmk/boards/handwired/boards/shields/rommana/Kconfig.defconfig
```kconfig
# Copyright (c) 2021 The ZMK Contributors
# SPDX-License-Identifier: MIT

if SHIELD_ROMMANA

config ZMK_KEYBOARD_NAME
    default "Rommana"

endif
```

## src/zmk/boards/handwired/boards/shields/testpad/Kconfig.defconfig
```kconfig
# Copyright (c) 2024 The ZMK Contributors
# SPDX-License-Identifier: MIT

if SHIELD_TESTPAD

config ZMK_KEYBOARD_NAME
    default "Testpad"

endif
```

## src/zmk/config/boards/handwired/boards/shields/aellopos/Kconfig.shield
```kconfig
# Copyright (c) 2021 The ZMK Contributors
# SPDX-License-Identifier: MIT

config SHIELD_AELLOPOS
    def_bool $(shields_list_contains,aellopos)
```

## src/zmk/config/boards/handwired/boards/shields/hw_hummingbird/Kconfig.defconfig
```kconfig
# Copyright (c) 2021 The ZMK Contributors
# SPDX-License-Identifier: MIT

if SHIELD_HW_HUMMINGBIRD

config ZMK_KEYBOARD_NAME
    default "Hummingbird"

endif
```

## src/zmk/config/boards/handwired/boards/shields/hw_hummingbird/Kconfig.shield
```kconfig
# Copyright (c) 2021 The ZMK Contributors
# SPDX-License-Identifier: MIT

config SHIELD_HW_HUMMINGBIRD
    def_bool $(shields_list_contains,hw_hummingbird)
```

## src/zmk/config/boards/handwired/boards/shields/rgbled_widget/Kconfig.defconfig
```kconfig
if SHIELD_RGBLED_WIDGET

config LED
    default y

config RGBLED_WIDGET_BATTERY_BLINK_MS
    int "Duration of battery level blink in ms"
    default 2000

config RGBLED_WIDGET_OUTPUT_BLINK_MS
    int "Duration of BLE connection status blink in ms"
    default 1000

config RGBLED_WIDGET_INTERVAL_MS
    int "Minimum wait duration between two blinks in ms"
    default 500

config RGBLED_WIDGET_BATTERY_LEVEL_HIGH
    int "High battery level percentage"
    default 80

config RGBLED_WIDGET_BATTERY_LEVEL_LOW
    int "Low battery level percentage"
    default 20

config RGBLED_WIDGET_BATTERY_LEVEL_CRITICAL
    int "Critical battery level percentage"
    default 5

endif
```

## src/zmk/config/boards/handwired/boards/shields/testpad/Kconfig.shield
```kconfig
# Copyright (c) 2024 The ZMK Contributors
# SPDX-License-Identifier: MIT

config SHIELD_TESTPAD
    def_bool $(shields_list_contains,testpad)
```

## src/zmk/keyboards/lowprokb.ca/corneish-zen-with-dongle/boards/shields/corneish-zen-with-dongle/Kconfig.defconfig
```kconfig
# Copyright (c) 2021 The ZMK Contributors
# SPDX-License-Identifier: MIT

if SHIELD_CORNEISH_ZEN_DONGLE

config ZMK_KEYBOARD_NAME
    default "Corne-ish Zen"

config ZMK_BLE
	default y

config ZMK_USB
	default y

config ZMK_SPLIT_ROLE_CENTRAL
    default y

config ZMK_SPLIT
	default y

endif
```

## src/zmk/keyboards/mabroum/rommana/boards/shields/rommana/Kconfig.shield
```kconfig
# Copyright (c) 2021 The ZMK Contributors
# SPDX-License-Identifier: MIT

config SHIELD_ROMMANA
    def_bool $(shields_list_contains,rommana)
```

## src/zmk/keyboards/mabroum/wired_rommana/boards/shields/wired_rommana/Kconfig.shield
```kconfig
# Copyright (c) 2021 The ZMK Contributors
# SPDX-License-Identifier: MIT

config SHIELD_WIRED_ROMMANA_LEFT
    def_bool $(shields_list_contains,wired_rommana_left)

config SHIELD_WIRED_ROMMANA_RIGHT
    def_bool $(shields_list_contains,wired_rommana_right)
```

## src/zmk/keyboards/rafaelromao/wired_diamond/boards/shields/wired_diamond/Kconfig.defconfig
```kconfig
# Copyright (c) 2021 The ZMK Contributors
# SPDX-License-Identifier: MIT

if SHIELD_WIRED_DIAMOND_LEFT

config ZMK_KEYBOARD_NAME
    default "Wired Diamond"

config ZMK_SPLIT_ROLE_CENTRAL
    default y

endif

if SHIELD_WIRED_DIAMOND_LEFT || SHIELD_WIRED_DIAMOND_RIGHT

config ZMK_BLE
    default n
config ZMK_SPLIT_BLE
    default n
config ZMK_SPLIT_WIRED
    default y

endif
```

## src/zmk/keyboards/wired_diamond/boards/shields/wired_diamond/Kconfig.shield
```kconfig
# Copyright (c) 2021 The ZMK Contributors
# SPDX-License-Identifier: MIT

config SHIELD_WIRED_DIAMOND_LEFT
    def_bool $(shields_list_contains,wired_diamond_left)

config SHIELD_WIRED_DIAMOND_RIGHT
    def_bool $(shields_list_contains,wired_diamond_right)
```

## src/zmk/keyboards/zen/config/west.yml
```yaml
manifest:
  remotes:
    - name: zmkfirmware
      url-base: https://github.com/LOWPROKB
  projects:
    - name: zmk
      remote: zmkfirmware
      revision: corne-ish-zen-v2
      import: app/west.yml
  self:
    path: config
```

## zmk/keyboards/bastardkb/dilemma/boards/shields/dilemma/Kconfig.defconfig
```kconfig
# Copyright (c) 2021 The ZMK Contributors
# SPDX-License-Identifier: MIT

if SHIELD_DILEMMA_CENTRAL_DONGLE || SHIELD_DILEMMA_CENTRAL_LEFT

config ZMK_KEYBOARD_NAME
    default "Dilemma"

config ZMK_SPLIT_ROLE_CENTRAL
    default y

endif

if SHIELD_DILEMMA_CENTRAL_DONGLE || SHIELD_DILEMMA_CENTRAL_LEFT || SHIELD_DILEMMA_PERIPHERAL_LEFT || SHIELD_DILEMMA_PERIPHERAL_RIGHT

config ZMK_SPLIT
    default y

endif
```
